## CMakeLists.txt
```
cmake_minimum_required(VERSION 3.20.0)

# Find Zephyr package
find_package(Zephyr REQUIRED HINTS $ENV{ZEPHYR_BASE})

# Project name
project(zephyr_threads_demo)

# Add source files
# full demo  for real-time primitive concepts
# target_sources(app PRIVATE src/main.c)

# Advanced concepts
# Reader-Writer demo
#target_sources(app PRIVATE src/demo_reader_writer.c)

# thread pool demo
#target_sources(app PRIVATE src/demo_thread_pool.c)

# barrier synchronization demo
# target_sources(app PRIVATE src/demo_barrier.c)

# memory slab demo
target_sources(app PRIVATE src/demo_memory_slab.c)
```

## prj.conf
```kconfig
# Zephyr RTOS Threading Project Configuration

# Enable console and UART for printk output
CONFIG_CONSOLE=y
CONFIG_UART_CONSOLE=y
CONFIG_SERIAL=y

# Enable printk for debugging
CONFIG_PRINTK=y

#Thread and Kernel configuration
CONFIG_MULTITHREADING=y
CONFIG_NUM_PREEMPT_PRIORITIES=15

# Work Queue Support
CONFIG_SYSTEM_WORKQUEUE_STACK_SIZE=2048

#Random Number Generator (for producer data)
CONFIG_ENTROPY_GENERATOR=y
CONFIG_TEST_RANDOM_GENERATOR=y

# Thread name support (for debugging)
CONFIG_THREAD_NAME=y

# Stack Sentinel (for stack overflow detection)
CONFIG_THREAD_STACK_INFO=y

# Memory Settings
CONFIG_HEAP_MEM_POOL_SIZE=16384
CONFIG_MAIN_STACK_SIZE=2048

# Assert and error handling
CONFIG_ASSERT=y
CONFIG_ASSERT_LEVEL=2
```

## src/main.c
```c
#include <zephyr/kernel.h>
#include <zephyr/sys/printk.h>
#include <zephyr/device.h>
#include <zephyr/random/random.h>

/* Thread Stack Sizes */
#define PRODUCER_STACK_SIZE 1024
#define CONSUMER_STACK_SIZE 1024
#define PRIORITY_STACK_SIZE 1024
#define WORKER_STACK_SIZE 1024
#define MONITOR_STACK_SIZE 1024

/* Thread Priorities (lower number = higher prriority in zephyr) */
#define PRODUCER_PRIORITY 5
#define CONSUMER_PRIORITY 5
#define HIGH_PRIORITY_THREAD 3
#define LOW_PRIORITY_THREAD 7
#define WORKER_PRIORITY 6
#define MONITOR_PRIORITY 4

/* Message queue parameters */
#define MSGQ_MAX_MSGS 10
#define MSG_SIZE sizeof(struct data_item)

/* Data sutructures */
struct data_item {
	uint32_t id;
	uint32_t value;
	char message[32];
};

/* Thraeds stacks */
K_THREAD_STACK_DEFINE(producer_stack, PRODUCER_STACK_SIZE);
K_THREAD_STACK_DEFINE(consumer_stack, CONSUMER_STACK_SIZE);
K_THREAD_STACK_DEFINE(high_prio_stack, PRIORITY_STACK_SIZE);
K_THREAD_STACK_DEFINE(low_prio_stack, PRIORITY_STACK_SIZE);
K_THREAD_STACK_DEFINE(worker_stack, WORKER_STACK_SIZE);
K_THREAD_STACK_DEFINE(monitor_stack, MONITOR_STACK_SIZE);

/* Thread control blocks */
struct k_thread producer_thread;
struct k_thread consumer_thread;
struct k_thread high_prio_thread;
struct k_thread low_prio_thread;
struct k_thread worker_thread;
struct k_thread monitor_thread;

/* Synchronization primitives */
K_MUTEX_DEFINE(shared_resource_mutex);
K_SEM_DEFINE(producer_sem, 0, 1);
K_SEM_DEFINE(consumer_sem, 0, 1);
K_MSGQ_DEFINE(data_msgq, MSG_SIZE, MSGQ_MAX_MSGS, 4);

/* Shared resources */
static uint32_t shared_counter = 0;
static uint32_t produced_items = 0;
static uint32_t consumed_items = 0;

/* Work Queue items */
K_WORK_DEFINE(my_work, NULL); // Will set handler later

/* Timer */
struct k_timer periodic_timer;

/* Forward declarations */
void producer_entry(void* p1, void* p2, void* p3);
void consumer_entry(void* p1, void* p2, void* p3);
void high_priority_entry(void* p1, void* p2, void* p3);
void low_priority_entry(void* p1, void* p2, void* p3);
void worker_entry(void* p1, void* p2, void* p3);
void monitor_entry(void* p1, void* p2, void* p3);
void timer_handler(struct k_timer *timer);
void work_handler(struct k_work* work);

/*
* CONCEPT 1 : PRODUCER-CONSUMER PATTERN withh Message Queue
* Demonstrates : Message queues, thread communication 
*/
void producer_entry(void *p1, void *p2, void *p3){
	struct data_item item;
	uint32_t count=0;
	
	printk("Producer thread started (ID : %p)\n", k_current_get());
	
	while(1){
	/* prepare data item*/
	item.id = count;
	item.value = sys_rand32_get() % 100;
	snprintk(item.message, sizeof(item.message), "Data-%u", count);
	
	/* send messages to queue (blocking if queue is full */
	if(k_msgq_put(&data_msgq, &item, K_FOREVER)==0){
		printk("[Producer] Sent: ID=%u, Value=%u, Msg=%s\n", item.id, item.value, item.message);
		/* Update shared counter with mutex protection */
		k_mutex_lock(&shared_resource_mutex, K_FOREVER);
		produced_items++;
		k_mutex_unlock(&shared_resource_mutex);

		count++;
	}
	/* Signal consumer that data is avaialable */
	k_sem_give(&consumer_sem);
	k_msleep(500);
	}
}

void consumer_entry(void* p1, void *p2, void *p3){
	struct data_item item;
	printk("Consumer thread started (ID : %p)\n",k_current_get());

	while(1){
	/* wait for producer signal */
	k_sem_take(&consumer_sem, K_FOREVER);

	/* receive message from queue (blocking if queue is empty)*/
	if(k_msgq_get(&data_msgq, &item, K_FOREVER)==0){
		printk("[CONSUMER] RECIEVED : ID=%u, Value=%u, Msg=%s\n", item.id , item.value, item.message);

		/* update shared counter with mutex protection */
		k_mutex_lock(&shared_resource_mutex, K_FOREVER);
		consumed_items++;
		k_mutex_unlock(&shared_resource_mutex);

		k_msleep(100); 
	}
	}
}
/*
* CCONCEPT 2 : PRIORITY DEMONSTRATION 
* shows how higher priority threads preempt lower priority threads 
*/
void high_priority_entry(void *p1, void *p2, void *p3){
	printk("High priority thread started (priority : %d)\n",
		k_thread_priority_get(k_current_get()));
	while(1){
	printk("[HIGH-PRIO] Running - I can preempt lower priority threads!\n");
	for(volatile int i=0;i<100000;i++){
	/* do some work*/
	}
	k_msleep(2000);
	}
}

void low_priority_entry(void *p1, void *p2, void *p3){
	printk("Low Priority thread started (priority : %d)\n",
		k_thread_priority_get(k_current_get()));
	while(1){
	printk("[LOW-PRIO] Running - I can get preempted by higher priority threads\n");

	for(volatile int i=0;i<100000;i++){
	/* busy work */
	}

	k_msleep(2000);
	}
}

/* 
* CONCEPT 3 : WORK QUEUE
* Demonstrates deferred work processing
*/

void work_handler(struct k_work *work){
	printk("[WORK-QUEUE] Processing deferred work\n");
	
	k_msleep(100);

	printk("[WORK-QUEUE] Work completed\n");
}

void worker_entry(void *p1, void *p2, void *p3){
	printk("Worker thread started\n");

	while(1){
	printk("[Worker] Submitting work to queue\n");
	k_work_submit(&my_work);
	
	k_msleep(3000);
	}
}

/*
* CONCEPT 4 : TIMER CALLBACK
* Periodic timer demonstartion
*/

void timer_handler(struct k_timer *timer){
	printk("[TIMER] periodic timer expired! system uptime : %lld ms\n", k_uptime_get());
}

/*
* CONCEPT 5 : SYSTEM MONITOR
* Monitors system state and demonstrates thread inspection
*/
void monitor_entry(void *p1, void *p2, void *p3){
	printk("Monitor thread started\n");
	while(1){
	k_msleep(5000);
	printk("\n================== SYSTEM STATE =====================\n");
	/* access shared resources safely */
	k_mutex_lock(&shared_resource_mutex, K_FOREVER);
	printk("Produced Items: %u\n", produced_items);
	printk("Consumed items: %u\n", consumed_items);
	printk("Shared counter : %u\n", shared_counter);
	k_mutex_unlock(&shared_resource_mutex);
	/* message queue statistics*/
	printk("Message Queue : %u/%u messages\n",
		k_msgq_num_used_get(&data_msgq),
		MSGQ_MAX_MSGS);
	
	printk("System update : %lld ms\n", k_uptime_get());
	printk("==========================================\n\n"); 
	}
}

int main(void){
	printk("\n================================================\n");
	printk("ZEPHYR RTOS THREADING DEMONSTRATION \n");
	printk("==================================================\n\n");
	
	/* initialize work handler*/
	k_work_init(&my_work, work_handler);

	/* initialize and start periodic timer (fires every 10 seconds*/
	k_timer_init(&periodic_timer, timer_handler, NULL);
	k_timer_start(&periodic_timer, K_MSEC(10000), K_MSEC(10000));
	
	/* create producer thread */
	k_thread_create(&producer_thread, producer_stack,
			K_THREAD_STACK_SIZEOF(producer_stack),
			producer_entry,
			NULL, NULL, NULL,
			PRODUCER_PRIORITY, 0, K_NO_WAIT);
	k_thread_name_set(&producer_thread, "producer");

	/* Create Consumer thread */
	k_thread_create(&consumer_thread, consumer_stack,
			K_THREAD_STACK_SIZEOF(consumer_stack),
			consumer_entry,
			NULL, NULL, NULL,
			CONSUMER_PRIORITY, 0, K_NO_WAIT);
	k_thread_name_set(&consumer_thread, "consumer");
	
	/* Create high priority thread */
	k_thread_create(&high_prio_thread, high_prio_stack,
			K_THREAD_STACK_SIZEOF(high_prio_stack),
			high_priority_entry,
			NULL, NULL, NULL,
			HIGH_PRIORITY_THREAD,0, K_NO_WAIT);
	k_thread_name_set(&high_prio_thread, "high-prio");
	
	/*create low priority thread */
	k_thread_create(&low_prio_thread, low_prio_stack,
			K_THREAD_STACK_SIZEOF(low_prio_stack),
			low_priority_entry,
			NULL, NULL, NULL,
			LOW_PRIORITY_THREAD, 0, K_NO_WAIT);
	k_thread_name_set(&low_prio_thread, "low-prio");

	/* Create worker thread*/
	k_thread_create(&worker_thread, worker_stack,
			K_THREAD_STACK_SIZEOF(worker_stack),
			worker_entry,
			NULL, NULL, NULL,
			WORKER_PRIORITY, 0, K_NO_WAIT);
	k_thread_name_set(&worker_thread, "worker");

	/* Create monitor thread*/
	k_thread_create(&monitor_thread, monitor_stack,
			K_THREAD_STACK_SIZEOF(monitor_stack),
			monitor_entry,
			NULL, NULL, NULL,
			MONITOR_PRIORITY, 0 , K_NO_WAIT);

	k_thread_name_set(&monitor_thread, "monitor");
	
	printk("All threads created and started\n");
	while(1){
		k_msleep(1000);
	}
	return 0;
}
```

## src/demo_barrier.c
```c
/* File : src/demo_barrier.c */
#include <zephyr/kernel.h>
#include <zephyr/sys/printk.h>
#include <zephyr/random/random.h>

#define NUM_BARRIER_THREADS 4

K_SEM_DEFINE(barrier_sem, 0, NUM_BARRIER_THREADS);
K_MUTEX_DEFINE(barrier_mutex);
static int barrier_count = 0;

void barrier_wait(void){
	k_mutex_lock(&barrier_mutex, K_FOREVER);
	barrier_count++;

	printk("Thread %p at barrier (count: %d/%d)|n",
	k_current_get(), barrier_count, NUM_BARRIER_THREADS);

	if(barrier_count == NUM_BARRIER_THREADS){
		printk("All threads reached barrier! Releasing... ***\n");
		for(int i=0;i<NUM_BARRIER_THREADS;i++){
			k_sem_give(&barrier_sem);
		}
		barrier_count = 0;
	}
	k_mutex_unlock(&barrier_mutex);

	k_sem_take(&barrier_sem, K_FOREVER);
	
}

void barrier_thread(void *p1, void *p2, void *p3){
	int thread_id = (int)p1;
	int iteration = 0;

	while(1){
		printk("[THREAD-%d] Iteration %d - Phase 1 starting\n",
			thread_id, iteration);

		/* simulate different work duration*/
		k_msleep(sys_rand32_get() % 1000 + 500);
		
		printk("[THREAD-%d] Iteration %d - Phase 1 done, waiting at barrier\n",
			thread_id, iteration);
		
		barrier_wait();

		printk("[THREAD-%d] Iteration %d - Phase 2 starting \n",
			thread_id, iteration);

		k_msleep(sys_rand32_get() % 1000 + 500);

		printk("[THREAD-%d] Iteration %d - Phase 2 done\n",
			thread_id, iteration);

		iteration++;
		k_msleep(1000);
		
	}
}

K_THREAD_STACK_ARRAY_DEFINE(barrier_stacks, NUM_BARRIER_THREADS, 1024);
struct k_thread barrier_threads[NUM_BARRIER_THREADS];

int main(void){
	
	printk("\n===================================");
	printk(" Barrier synchonization demo \n");
	printk(" %d threads will synchronize at barriers\n", NUM_BARRIER_THREADS);
	printk("=====================================\n\n");

	for(int i=0;i< NUM_BARRIER_THREADS; i++){
		k_thread_create(&barrier_threads[i], barrier_stacks[i],
				K_THREAD_STACK_SIZEOF(barrier_stacks[i]),
				barrier_thread, (void *)i, NULL, NULL, 
				5, 0, K_NO_WAIT);
	}

	while(1){
		k_msleep(1000);
	}

	return 0;
}
```

## src/demo_memory_slab.c
```c
/* File : demo_memory_slab.c */
#include <zephyr/kernel.h>
#include <zephyr/sys/printk.h>

#define SLAB_SIZE 320
#define BLOCK_SIZE 64
#define NUM_BLOCKS (SLAB_SIZE / BLOCK_SIZE)
#define NUM_USERS 4

K_MEM_SLAB_DEFINE(my_slab, BLOCK_SIZE, NUM_BLOCKS, 4);

struct data_block {
    uint32_t thread_id;
    uint32_t allocation_num;
    uint32_t timestamp;
    uint8_t data[BLOCK_SIZE - 3 * sizeof(uint32_t)];
};

static int total_allocations = 0;
static int total_failures = 0;
static int blocks_in_use = 0;

K_MUTEX_DEFINE(stats_mutex);

void memory_slab_user(void *p1, void *p2, void *p3){
    int thread_id = (int)p1;
    int my_allocation_count = 0;
    int my_failures = 0;

    printk("[USER-%d] Started\n", thread_id);

    while(my_allocation_count < 5){ // each thread does 5 allocations
        struct data_block *block;

        printk("[USER-%d] Attempting allocation #%d...\n", thread_id, my_allocation_count);

        int ret = k_mem_slab_alloc(&my_slab,  (void **)&block, K_MSEC(2000));

        if(ret == 0){
            /* Success */
            k_mutex_lock(&stats_mutex, K_FOREVER);
            total_allocations++;
            blocks_in_use++;
            k_mutex_unlock(&stats_mutex);

            uint32_t free_bloks = k_mem_slab_num_free_get(&my_slab);
            printk("[USER-%d] Allocation #%d successful. Free blocks left: %d\n",
                   thread_id, my_allocation_count, free_bloks);

            /* Fill in data */
            block->thread_id = thread_id;
            block->allocation_num = my_allocation_count;
            block->timestamp = k_uptime_get_32();

            /* fill data array with pattern*/
            for(int i=0; i < sizeof(block->data);i++){
                block->data[i] = (thread_id * 16 + i) & 0xFF;
            }

            /* Simulate work - different threads hold blocks for different times */
            uint32_t hold_time = 500 + (thread_id * 200);
            printk("[USER-%d] Working, it will hold block for %d ms\n", thread_id, hold_time);
            k_sleep(K_MSEC(hold_time));

            /* Verify data integrity */
            bool data_ok = true;
            for(int i=0; i < sizeof(block->data); i++){
                if(block->data[i] != (uint8_t)((thread_id * 16 + i) & 0xFF)){
                    data_ok = false;
                    break;
                }
            }

            if(data_ok){
                printk("[USER-%d] Data integrity check passed for allocation #%d\n",
                       thread_id, my_allocation_count);
            } else {
                printk("[USER-%d] Data integrity check FAILED for allocation #%d\n",
                       thread_id, my_allocation_count);
            }

            /* Free the block */
            k_mem_slab_free(&my_slab, (void *)block);

            k_mutex_lock(&stats_mutex, K_FOREVER);
            blocks_in_use--;
            k_mutex_unlock(&stats_mutex);

            free_bloks = k_mem_slab_num_free_get(&my_slab);
            printk("[USER-%d] Freed allocation #%d. Free blocks left: %d\n",
                   thread_id, my_allocation_count, free_bloks);

            my_allocation_count++;


        }else{
            /* Allocation failed */
            k_mutex_lock(&stats_mutex, K_FOREVER);
            total_failures++;
            k_mutex_unlock(&stats_mutex);

            my_failures++;
            printk("[USER-%d] Allocation #%d FAILED! (Timeout or no memory)\n",
                   thread_id, my_allocation_count);
        }
        /* Short pause between allocations */
        k_msleep(200);
    }

    printk("[USER-%d] Finished. Total allocations: %d, Failures: %d\n",
           thread_id, my_allocation_count, my_failures);
}

K_THREAD_STACK_ARRAY_DEFINE(user_stacks, NUM_USERS, 1024);
struct k_thread user_threads[NUM_USERS];

K_THREAD_STACK_DEFINE(monitor_stack, 1024);
struct k_thread monitor_thread;

/* Monitor Thread */
void monitor_thread_entry(void *p1, void *p2, void *P3){
    int last_allocations = 0;
    k_msleep(2000); /* Initial delay */
    while(1){
        k_msleep(3000);

        k_mutex_lock(&stats_mutex, K_FOREVER);
        int allocs = total_allocations;
        int fails = total_failures;
        int in_use = blocks_in_use;
        k_mutex_unlock(&stats_mutex);

        printk("[MONITOR] Total Allocations: %d (Delta: %d), Total Failures: %d, Blocks in use: %d\n",
               allocs, allocs - last_allocations, fails, in_use);

        int new_allocs = allocs - last_allocations;
        last_allocations = allocs;

        uint32_t used = k_mem_slab_num_used_get(&my_slab);
        uint32_t free = k_mem_slab_num_free_get(&my_slab);
        printk("\n      Memory Slab Statistics           \n");
        printk("\n");
        printk(" Total Allocations:  %3d              \n", allocs);
        printk(" Total Failures:     %3d              \n", fails);
        printk(" Blocks Used:        %3u/%3u          \n", used, NUM_BLOCKS);
        printk(" Blocks Free:        %3u/%3u          \n", free, NUM_BLOCKS);
        printk(" Rate (last 3s):     %3d allocs       \n", new_allocs);
        printk(" Success Rate:       %3d%%            \n", 
               (allocs + fails > 0) ? (allocs * 100 / (allocs + fails)) : 100);

        printk("---------------------------------------\n");

        if(allocs >= NUM_USERS * 5){
            printk("[MONITOR] All user threads completed their allocations. Exiting monitor.\n");
            break;
        }
        
    }

}

int main(void){
    printk("\nMemory Slab Demo \n\n");

    /* Start user threads */
    for(int i=0; i < NUM_USERS; i++){
        k_thread_create(&user_threads[i], user_stacks[i], K_THREAD_STACK_SIZEOF(user_stacks[i]),
                        memory_slab_user, (void *)(i+1), NULL, NULL,
                        7, 0, K_NO_WAIT);
    }

    /* Start monitor thread */
    k_thread_create(&monitor_thread, monitor_stack, K_THREAD_STACK_SIZEOF(monitor_stack),
                    monitor_thread_entry, NULL, NULL, NULL,
                    5, 0, K_NO_WAIT);

    printk("All threads started!\n\n");
    
    /* Main thread waits */
    while (1) {
        k_msleep(10000);
    }


    return 0;
}
```

## src/demo_reader_writer.c
```c
#include <zephyr/kernel.h>
#include <zephyr/sys/printk.h>

/* RW-lock maison : 
 * - Un mutex pour protéger reader_count
 * - Un semaphore binaire pour exclure les writers
 */
K_MUTEX_DEFINE(reader_count_mutex);
K_SEM_DEFINE(rw_sem, 1, 1);  // 1 = libre, 0 = occupé

static int reader_count = 0;
static int shared_data = 0;

/* ===========================
 *       READER THREAD
 * =========================== */
void reader_thread(void *p1, void *p2, void *p3)
{
    int thread_id = (int)p1;

    while (1) {

        /* ENTRY SECTION */
        k_mutex_lock(&reader_count_mutex, K_FOREVER);
        reader_count++;
        bool first_reader = (reader_count == 1);
        k_mutex_unlock(&reader_count_mutex);

        if (first_reader) {
            /* Le premier lecteur bloque le writer */
            k_sem_take(&rw_sem, K_FOREVER);
        }

        /* CRITICAL SECTION (lecture partagée) */
        printk("[READER-%d] Reading data: %d, TIME=%lld\n",
               thread_id, shared_data, k_uptime_get());

        k_msleep(100);  // lecture simulée

        /* EXIT SECTION */
        k_mutex_lock(&reader_count_mutex, K_FOREVER);
        reader_count--;
        bool last_reader = (reader_count == 0);
        k_mutex_unlock(&reader_count_mutex);

        if (last_reader) {
            /* Le dernier lecteur libère le writer */
            k_sem_give(&rw_sem);
        }

        k_msleep(1000);
    }
}

void writer_thread(void *p1, void *p2, void *p3){

    int thread_id = (int)p1;

    while (1) {


        /* SECTION CRITIQUE (exclusion totale) */
        k_sem_take(&rw_sem, K_FOREVER);

        shared_data++;
        printk("[WRITER-%d] Writing data: %d\n", thread_id, shared_data);

        k_sem_give(&rw_sem);

        k_msleep(1000);
    }
	
}

/* Thread stacks */
K_THREAD_STACK_DEFINE(reader1_stack, 1024);
K_THREAD_STACK_DEFINE(reader2_stack, 1024);
K_THREAD_STACK_DEFINE(reader3_stack, 1024);
K_THREAD_STACK_DEFINE(writer1_stack, 1024);


struct k_thread reader1_data;
struct k_thread reader2_data;
struct k_thread reader3_data;
struct k_thread writer1_data;



int main(void){
	printk("\n=== Reader-Writer Lock Demo ===\n\n");

	/* Create  3 readers*/
	k_thread_create(&reader1_data, reader1_stack,
			K_THREAD_STACK_SIZEOF(reader1_stack),
			reader_thread, (void *)1,  NULL, NULL,
			5, 0, K_NO_WAIT);
	
	k_thread_create(&reader2_data, reader2_stack,
			K_THREAD_STACK_SIZEOF(reader2_stack),
			reader_thread, (void *)2,  NULL, NULL,
			5, 0, K_NO_WAIT);

	k_thread_create(&reader3_data, reader3_stack,
			K_THREAD_STACK_SIZEOF(reader3_stack),
			reader_thread, (void *)3,  NULL, NULL,
			5, 0, K_NO_WAIT);

	k_thread_create(&writer1_data, writer1_stack,
			K_THREAD_STACK_SIZEOF(writer1_stack),
			writer_thread, (void *)1,  NULL, NULL,
			5, 0, K_NO_WAIT);


	

	printk("Threads started\n\n");
	while(1){
		k_msleep(1000);
	}
	return 0;

}
```

## src/demo_thread_pool.c
```c
/* FILE: src/demo_thread_pool.c */
#include <zephyr/kernel.h>
#include <zephyr/sys/printk.h>
#include <zephyr/random/random.h>

#define THREAD_POOL_SIZE 4
#define TASK_QUEUE_SIZE 10

struct task {
    void (*function)(void *);
    void *arg;
    int task_id;
};

K_MSGQ_DEFINE(task_queue, sizeof(struct task), TASK_QUEUE_SIZE, 4);

/* Examples tasks */
void fast_task(void *arg){
    int task_id = (int)arg;
    printk("[task-%d] fast task executing\n", task_id);
    k_msleep(100);
    printk("[task-%d] fast task done\n", task_id);
}

void medium_task(void *arg){
    int task_id = (int)arg;
    printk("[task-%d] mediumm task executing\n", task_id);
    k_msleep(300);
    printk("[task-%d] medium task done\n", task_id);
}

void slow_task(void *arg){
    int task_id = (int)arg;
    printk("[task-%d] slow task executing\n", task_id);
    k_msleep(500);
    printk("[task-%d] slow task done\n", task_id);
}

void very_slow_task(void *arg){
    int task_id = (int)arg;
    printk("[task-%d] very slow task executing\n", task_id);
    k_msleep(1000);
    printk("[task-%d] very slow task done\n", task_id);
}
/* Worker thread function */
void worker_pool_thread(void *p1, void *p2, void *p3){
    int worker_id = (int)p1;
    struct task t;
    printk("[WORKER-%d] started and ready for work\n",worker_id);
    while(1){
        if(k_msgq_get(&task_queue, &t, K_FOREVER)==0){
            printk("[WORKER-%d] Got task %d\n", worker_id, t.task_id);
            t.function(t.arg);
            printk("[WORKER-%d] Completed task %d\n", worker_id, t.task_id);
        }
    }
}

void task_dispatcher(void *p1, void *p2, void *p3){
    struct task t;
    int task_count = 0;
    void (*task_types[])(void *) = {fast_task, medium_task, slow_task, very_slow_task};
    const char *task_names[] = {"fast", "medium", "slow", "very_slow"};

    k_msleep(1000); // Wait for workers to be ready
    printk("[DISPATCHER] Starting to dispatch tasks\n");
    while(1){
        int type = sys_rand32_get() % 4;

        t.function = task_types[type];
        t.arg = (void *)task_count;
        t.task_id =task_count;

        printk("[DISPATCHER] Dispatching %s task %d (QUEUE: %u/%u)\n",
        task_names[type], task_count, 
        k_msgq_num_used_get(&task_queue),
        TASK_QUEUE_SIZE);

        if(k_msgq_put(&task_queue, &t, K_NO_WAIT) !=0){
            printk("[DISPATCHER] Task queue full,task %d dropped \n", task_count);
        }
        task_count++;
        k_msleep(500);
    }
}

K_THREAD_STACK_ARRAY_DEFINE(worker_stacks, THREAD_POOL_SIZE, 1024);
struct k_thread worker_threads[THREAD_POOL_SIZE];

K_THREAD_STACK_DEFINE(dispatcher_stack, 1024);
struct k_thread dispatcher_thread;

int main(void){
    printk("\n=== Thread Pool Demo ===\n\n");

    /* Create worker threads */
    for(int i=0; i<THREAD_POOL_SIZE; i++){
        k_thread_create(&worker_threads[i], worker_stacks[i],
            K_THREAD_STACK_SIZEOF(worker_stacks[i]),
            worker_pool_thread, (void *)i, NULL, NULL,
            5, 0, K_NO_WAIT);
    }

    /* Create dispatcher thread */
    k_thread_create(&dispatcher_thread, dispatcher_stack,
        K_THREAD_STACK_SIZEOF(dispatcher_stack),
        task_dispatcher, NULL, NULL, NULL,
        5, 0, K_NO_WAIT);

    return 0;
}
```
